## buildroot/libnanopb/Config.in
```kconfig
config BR2_PACKAGE_LIBNANOPB
	bool "libnanopb"
	help
	  Nanopb is a small code-size Protocol Buffers implementation
	  in ansi C. It is especially suitable for use in microcontrollers,
	  but fits any memory-constrained system.

	  https://github.com/nanopb/nanopb
```

## buildroot/package/uac2-i2s-router/Config.in
```kconfig
config BR2_PACKAGE_UAC2_I2S_ROUTER
	bool "uac2-i2s-router"
	select BR2_PACKAGE_ALSA_LIB
	help
	  UAC2 to I2S audio routing daemon
```

## ext_tree/Config.in
```kconfig
menu "Custom packages"
	source "../ext_tree/package/uac2_router/Config.in"
	source "../ext_tree/package/buffer_daemon/Config.in"
endmenu
```

## ext_tree/package/buffer_daemon/Config.in
```kconfig
config BR2_PACKAGE_BUFFER_DAEMON
	bool "buffer_daemon"
	help
	  Buffer monitoring daemon for UAC2 audio feedback control.
	  Monitors I2S playback buffer status and adjusts USB feedback
	  to maintain optimal buffer fill ratio and prevent audio delays.
	  
	  Features:
	  - Real-time buffer monitoring with 15-second averaging
	  - Hysteresis-based feedback control to prevent oscillation
	  - Gradual adjustment with configurable step size
	  - Filtering of invalid/empty buffer readings
	  - Sysfs feedback control for UAC2 gadget

	  https://github.com/PureCore/buffer_daemon
```

## ext_tree/package/qobuz-connect/Config.in
```kconfig
config BR2_PACKAGE_QOBUZ_CONNECT
	bool "qobuz-connect-dev"
	select BR2_PACKAGE_ALSA_LIB
	select BR2_PACKAGE_AVAHI
	select BR2_PACKAGE_CIVETWEB_LIB
	help
	  Qobuz Connect for building custom Qobuz Connect players.
	  
	  Includes the sample console application and all required libraries.
	  
	  https://qobuz.com/
```

## ext_tree/package/simple-router/Config.in
```kconfig
config BR2_PACKAGE_SIMPLE_ROUTER
	bool "simple-router"
	help
	  Simple USB UAC2 to I2S audio router
```

## ext_tree/package/status-monitor/Config.in
```kconfig
config BR2_PACKAGE_STATUS_MONITOR
    bool "status-monitor"
    help
      PureFox system status monitor daemon.
      
      This package provides a lightweight C daemon that monitors
      system status including audio services, ALSA configuration,
      and volume levels. It writes status to a JSON file for
      efficient web interface polling.
      
      Features:
      - Monitors active audio services (NAA, RAAT, MPD, etc.)
      - Tracks ALSA output configuration (I2S/USB)
      - Reports volume and mute status
      - Minimal CPU usage (C implementation)
      - JSON output for web interface
```

## ext_tree/package/tidal-connect/Config.in
```kconfig
config BR2_PACKAGE_TIDAL_CONNECT
	bool "tidal-connect"
	help
	  Tidal Connect streaming service client
```

## ext_tree/package/uac2_router/Config.in
```kconfig
config BR2_PACKAGE_UAC2_ROUTER
	bool "uac2_router"
	select BR2_PACKAGE_ALSA_LIB
	help
	  USB UAC2 to I2S audio routing daemon.
	  
	  Zero-copy audio passthrough from USB Audio Class 2.0
	  to I2S DAC with automatic sample rate detection.
	  
	  Supports PCM 44.1-384kHz, 16/24/32-bit.
```

## ext_tree/package/wasapi-router/Config.in
```kconfig
config BR2_PACKAGE_WASAPI_ROUTER
	bool "wasapi-router"
	help
	  Advanced USB UAC2 to I2S audio router with WASAPI support
	  Supports dynamic format switching for WASAPI exclusive mode
	  Handles 16/24/32-bit formats and all standard sample rates
```
